/**
 * @cliArgs --device "MSPM0G350X" --part "Default" --package "LQFP-64(PM)" --product "mspm0_sdk@2.07.00.05"
 * @versions {"tool":"1.21.1+3772"}
 */

/**
 * Import the modules used in this configuration.
 */
const GPIO   = scripting.addModule("/ti/driverlib/GPIO", {}, false);
const GPIO1  = GPIO.addInstance();
const GPIO2  = GPIO.addInstance();
const GPIO3  = GPIO.addInstance();
const PWM    = scripting.addModule("/ti/driverlib/PWM", {}, false);
const PWM1   = PWM.addInstance();
const SYSCTL = scripting.addModule("/ti/driverlib/SYSCTL");

/**
 * Write custom configuration values to the imported modules.
 */
const divider9       = system.clockTree["UDIV"];
divider9.divideValue = 2;

const multiplier2         = system.clockTree["PLL_QDIV"];
multiplier2.multiplyValue = 4;

const mux4       = system.clockTree["EXHFMUX"];
mux4.inputSelect = "EXHFMUX_XTAL";

const mux8       = system.clockTree["HSCLKMUX"];
mux8.inputSelect = "HSCLKMUX_SYSPLL0";

const mux12       = system.clockTree["SYSPLLMUX"];
mux12.inputSelect = "zSYSPLLMUX_HFCLK";

const pinFunction4     = system.clockTree["HFXT"];
pinFunction4.inputFreq = 40;
pinFunction4.enable    = true;

GPIO1.$name                          = "OLED";
GPIO1.associatedPins.create(2);
GPIO1.associatedPins[0].$name        = "OLED_SCL";
GPIO1.associatedPins[0].initialValue = "SET";
GPIO1.associatedPins[0].assignedPort = "PORTB";
GPIO1.associatedPins[0].assignedPin  = "26";
GPIO1.associatedPins[1].$name        = "OLED_SDA";
GPIO1.associatedPins[1].initialValue = "SET";
GPIO1.associatedPins[1].assignedPort = "PORTB";
GPIO1.associatedPins[1].assignedPin  = "27";

const Board = scripting.addModule("/ti/driverlib/Board", {}, false);

GPIO2.$name                              = "Motor";
GPIO2.associatedPins.create(2);
GPIO2.associatedPins[0].$name            = "INA";
GPIO2.associatedPins[0].assignedPort     = "PORTB";
GPIO2.associatedPins[0].assignedPin      = "11";
GPIO2.associatedPins[0].internalResistor = "PULL_UP";
GPIO2.associatedPins[0].pin.$assign      = "PB11";
GPIO2.associatedPins[1].$name            = "INB";
GPIO2.associatedPins[1].internalResistor = "PULL_UP";
GPIO2.associatedPins[1].assignedPort     = "PORTB";
GPIO2.associatedPins[1].assignedPin      = "14";

GPIO3.$name                              = "Key";
GPIO3.port                               = "PORTB";
GPIO3.associatedPins[0].direction        = "INPUT";
GPIO3.associatedPins[0].assignedPin      = "21";
GPIO3.associatedPins[0].internalResistor = "PULL_UP";
GPIO3.associatedPins[0].$name            = "PIN_21";

PWM1.$name                 = "PWM";
PWM1.clockDivider          = 8;
PWM1.timerCount            = 100;
PWM1.clockPrescale         = 2;
PWM1.timerStartTimer       = true;
PWM1.pwmMode               = "EDGE_ALIGN_UP";
PWM1.ccIndex               = [1];
PWM1.peripheral.$assign    = "TIMG0";
PWM1.ccp1PinConfig.$name   = "ti_driverlib_gpio_GPIOPinGeneric0";
PWM1.PWM_CHANNEL_1.$name   = "ti_driverlib_pwm_PWMTimerCC0";
PWM1.PWM_CHANNEL_1.ccValue = 100;

SYSCTL.forceDefaultClkConfig = true;
SYSCTL.clockTreeEn           = true;

/**
 * Pinmux solution for unlocked pins/peripherals. This ensures that minor changes to the automatic solver in a future
 * version of the tool will not impact the pinmux you originally saw.  These lines can be completely deleted in order to
 * re-solve from scratch.
 */
pinFunction4.peripheral.$suggestSolution           = "SYSCTL";
pinFunction4.peripheral.hfxInPin.$suggestSolution  = "PA5";
pinFunction4.peripheral.hfxOutPin.$suggestSolution = "PA6";
GPIO1.associatedPins[0].pin.$suggestSolution       = "PB26";
GPIO1.associatedPins[1].pin.$suggestSolution       = "PB27";
Board.peripheral.$suggestSolution                  = "DEBUGSS";
Board.peripheral.swclkPin.$suggestSolution         = "PA20";
Board.peripheral.swdioPin.$suggestSolution         = "PA19";
GPIO2.associatedPins[1].pin.$suggestSolution       = "PB14";
GPIO3.associatedPins[0].pin.$suggestSolution       = "PB21";
PWM1.peripheral.ccp1Pin.$suggestSolution           = "PA13";
